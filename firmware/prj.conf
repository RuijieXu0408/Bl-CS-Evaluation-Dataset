## prj.conf
```kconfig
#
# Copyright (c) 2024 Nordic Semiconductor ASA
#
# SPDX-License-Identifier: LicenseRef-Nordic-5-Clause
#

CONFIG_NCS_SAMPLES_DEFAULTS=y
CONFIG_DK_LIBRARY=y

CONFIG_BT=y
CONFIG_BT_PERIPHERAL=y
CONFIG_BT_SMP=y
CONFIG_BT_DEVICE_NAME="Nordic CS Reflector A"
CONFIG_BT_MAX_CONN=1
CONFIG_BT_GAP_AUTO_UPDATE_CONN_PARAMS=n
CONFIG_BT_BONDABLE=n

# The Ranging Profile recommends a MTU of at least 247 octets.
CONFIG_BT_L2CAP_TX_MTU=498
CONFIG_BT_BUF_ACL_TX_SIZE=502
CONFIG_BT_BUF_ACL_RX_SIZE=502
CONFIG_BT_CTLR_DATA_LENGTH_MAX=251
CONFIG_BT_CTLR_PHY_2M=y

# This reduces RAM usage. Additional RAM is needed to support optional
# features such as mode 3 or multiantenna. Change or remove these if
# using those features
CONFIG_BT_RAS_MODE_3_SUPPORTED=n
CONFIG_BT_RAS_MAX_ANTENNA_PATHS=1
CONFIG_BT_CTLR_SDC_CS_MAX_ANTENNA_PATHS=1
CONFIG_BT_CTLR_SDC_CS_NUM_ANTENNAS=1
CONFIG_BT_CTLR_SDC_CS_STEP_MODE3=n
CONFIG_BT_CTLR_SDC_CS_ROLE_REFLECTOR_ONLY=y

# Disabling the CS Test command reduces flash usage
CONFIG_BT_CTLR_CHANNEL_SOUNDING_TEST=n

# This allows CS and ACL to use different PHYs
CONFIG_BT_TRANSMIT_POWER_CONTROL=y

CONFIG_BT_CHANNEL_SOUNDING=y
CONFIG_BT_RAS=y
CONFIG_BT_RAS_RRSP=y

CONFIG_LOG=y
CONFIG_BT_LOG_LEVEL_INF=y
CONFIG_SERIAL=y
CONFIG_UART_CONSOLE=y



CONFIG_BT_PRIVACY=n
CONFIG_BT_SETTINGS=y

# CONFIG_LOG_MODE_DEFERRED=y
# CONFIG_UART_LINE_CTRL=n
# CONFIG_USB_DEVICE_STACK=n
# CONFIG_UART_LINE_CTRL=n
# CONFIG_USB_DEVICE_STACK=n
# CONFIG_USB_DEVICE_PRODUCT="n/a"

# # 2. 确保日志不会导致 CPU 挂起
# CONFIG_LOG=y
# CONFIG_LOG_MODE_DEFERRED=y
# CONFIG_LOG_BUFFER_SIZE=2048
# # 关键：即便串口没人接，日志也要直接丢弃，不准卡住 CPU
# CONFIG_LOG_BACKEND_UART_OUTPUT_DICTIONARY=n

# # 3. 提高连接稳定性（适配移动电源）
# CONFIG_BT_CTLR_TX_PWR_DYNAMIC_CONTROL=y
# # 禁用深度睡眠，防止移动电源因电流过小而关闭 (仅测试用)
# CONFIG_PM=n
```

## antenna2.conf
```kconfig
# Android negotiates the largest antenna configuration both sides advertise.
# With the reflector reporting 2 antennas it selects ACI=7 (a 2:2 configuration)
# = 4 antenna paths, so the controller and RAS path budgets must both cover 4,
# otherwise its own controller rejects LE CS Set Procedure Parameters with 0x11.
# Measured: this configuration is the only one that produced ranging results
# (121-122 onResults per session); the stock 1-antenna/2-path setting never did.
CONFIG_BT_CTLR_SDC_CS_NUM_ANTENNAS=2
CONFIG_BT_CTLR_SDC_CS_MAX_ANTENNA_PATHS=4
CONFIG_BT_RAS_MAX_ANTENNA_PATHS=4
```

## cs_scheduling.conf
```kconfig
# Let a Channel Sounding subevent fit inside Android's connection interval.
#
# Android fixes the connection interval at 30 ms and negotiates large interlude
# timings (T_IP1/T_IP2/T_FCS), which makes one CS subevent tens of milliseconds
# long. The SoftDevice Controller reserves at most
# CONFIG_BT_CTLR_SDC_MAX_CONN_EVENT_LEN_DEFAULT microseconds (default 7500) for
# the connection event, so the subevent plus the ACL reservation does not fit and
# the reflector rejects the procedure at the link layer.
#
# The initiator sees that as LE CS Procedure Enable failing with
# UNSUPPORTED_LMP_OR_LL_PARAMETER (0x20) after four retries, while the reflector
# logs nothing past "CS security enabled" -- it never reaches the host.
#
# Raise the reservation to the full 30 ms connection interval.
# The value is only applied when the override flag is also set; without it the
# controller silently keeps its 7500 us default.
CONFIG_BT_CTLR_SDC_MAX_CONN_EVENT_LEN_DEFAULT_OVERRIDE=y
CONFIG_BT_CTLR_SDC_MAX_CONN_EVENT_LEN_DEFAULT=30000

# Let the initiating device control PHY updates.
#
# Backported from the v3.4.0 upstream sample's prj.conf, which added this line
# with the comment "Let the initiating device control the PHY updates". An
# auto-initiated PHY update from the reflector can collide with the initiator's
# own CS setup.
CONFIG_BT_AUTO_PHY_UPDATE=n
```

## debug_ras.conf
```kconfig
# Temporary diagnostic fragment: verbose RAS / CS logging on the reflector
CONFIG_BT_RAS_RRSP_LOG_LEVEL_DBG=y
CONFIG_LOG_BUFFER_SIZE=4096
CONFIG_LOG_MODE_DEFERRED=y
CONFIG_BT_SMP_LOG_LEVEL_DBG=y
CONFIG_BT_KEYS_LOG_LEVEL_DBG=y
```

## name_b.conf
```kconfig
# Second reflector. Each board must advertise a distinct name, otherwise the
# scan list and the app's per-device state cannot tell them apart.
CONFIG_BT_DEVICE_NAME="Nordic CS Reflector B"
```

## rebonding.conf
```kconfig
# Let a peer re-pair when it has forgotten its side of the bond.
#
# Zephyr refuses a pairing attempt from a peer that already has a bond here;
# the Kconfig help says the old bond "has to be explicitly deleted with
# bt_unpair" first. That restriction is why main() used to call bt_unpair() on
# every boot -- which destroyed the bond after every disconnect and broke
# ranging entirely (see the comment in src/main.c).
#
# Keeping the bond is what we want, but the phone can still drop its own copy
# (user taps "forget", Bluetooth is reset, the OS clears it). Without this
# option the reflector then rejects re-pairing with SMP_PAIR_FAIL_UNKNOWN and
# the device becomes permanently unusable until its flash is erased.
#
# Trade-off: this lets someone spoofing the peer address replace an existing
# unauthenticated bond. Acceptable for a lab development board using Just Works
# pairing, which offers no MITM protection to begin with.
CONFIG_BT_SMP_ALLOW_UNAUTH_OVERWRITE=y

# Key storage must have room for a new bond.
#
# CONFIG_BT_MAX_PAIRED defaults to 1, so a single stored bond fills the pool.
# When the phone had forgotten its side and re-paired from a fresh resolvable
# address, the reflector could not allocate a slot and rejected the pairing:
#
#   bt_keys_get_addr: unable to create keys for ... (random)
#   smp_pairing_req:  Unable to get keys for ... (random)
#
# Android reports that as SMP_PAIR_FAIL_UNKNOWN and the board becomes
# unpairable. This is the other half of what boot-time bt_unpair() was hiding:
# wiping bonds always freed the one slot.
CONFIG_BT_MAX_PAIRED=4
```

## src/main.c
```c
/*
 * Copyright (c) 2024 Nordic Semiconductor ASA
 *
 * SPDX-License-Identifier: LicenseRef-Nordic-5-Clause
 */

/** @file
 *  @brief Channel Sounding Reflector with Ranging Responder sample
 */

#include <zephyr/types.h>
#include <zephyr/kernel.h>
#include <zephyr/bluetooth/bluetooth.h>
#include <zephyr/sys/reboot.h>
#include <zephyr/bluetooth/conn.h>
#include <zephyr/bluetooth/uuid.h>
#include <zephyr/bluetooth/cs.h>
#include <bluetooth/services/ras.h>
#include <zephyr/settings/settings.h>
#include <dk_buttons_and_leds.h>

#include <zephyr/logging/log.h>
LOG_MODULE_REGISTER(app_main, LOG_LEVEL_INF);

#define CON_STATUS_LED DK_LED1

static K_SEM_DEFINE(sem_connected, 0, 1);

static struct bt_conn *connection;

static const struct bt_data ad[] = {
	BT_DATA_BYTES(BT_DATA_FLAGS, (BT_LE_AD_GENERAL | BT_LE_AD_NO_BREDR)),
	BT_DATA_BYTES(BT_DATA_UUID16_ALL, BT_UUID_16_ENCODE(BT_UUID_RANGING_SERVICE_VAL)),
	BT_DATA(BT_DATA_NAME_COMPLETE, CONFIG_BT_DEVICE_NAME, sizeof(CONFIG_BT_DEVICE_NAME) - 1),
};

static void adv_restart_work_handler(struct k_work *work)
{
	ARG_UNUSED(work);

	int err = bt_le_adv_start(BT_LE_ADV_CONN_FAST_2, ad, ARRAY_SIZE(ad), NULL, 0);

	if (err == -EALREADY) {
		return;
	} else if (err) {
		LOG_ERR("Advertising failed to restart (err %d)", err);
	} else {
		LOG_INF("Advertising restarted, device is discoverable again.");
	}
}

static K_WORK_DEFINE(adv_restart_work, adv_restart_work_handler);

static void connected_cb(struct bt_conn *conn, uint8_t err)
{
	char addr[BT_ADDR_LE_STR_LEN];

	(void)bt_addr_le_to_str(bt_conn_get_dst(conn), addr, sizeof(addr));
	LOG_INF("Connected to %s (err 0x%02X)", addr, err);

	if (err) {
		bt_conn_unref(conn);
		connection = NULL;
	}

	connection = bt_conn_ref(conn);

	k_sem_give(&sem_connected);

	dk_set_led_on(CON_STATUS_LED);
}

static void disconnected_cb(struct bt_conn *conn, uint8_t reason)
{
	LOG_INF("Disconnected (reason 0x%02X)", reason);

	bt_conn_unref(conn);
	connection = NULL;

	dk_set_led_off(CON_STATUS_LED);

	/* Restart advertising instead of rebooting.
	 *
	 * This used to call sys_reboot(SYS_REBOOT_COLD). A cold reboot tears down the
	 * whole controller on every disconnect, which loses all Channel Sounding state
	 * and makes the next session flaky: the initiator reuses its cached CS config
	 * for a controller that has just been reset, and CS Procedure Enable then fails
	 * with UNSUPPORTED_LMP_OR_LL_PARAMETER (0x20).
	 *
	 * bt_le_adv_start() must not be called directly from this callback: the
	 * connection object is still being released, so it can fail with -EAGAIN.
	 * Submit it to the system work queue instead.
	 */
	k_work_submit(&adv_restart_work);
}

static void remote_capabilities_cb(struct bt_conn *conn,
				   uint8_t status,
				   struct bt_conn_le_cs_capabilities *params)
{
	ARG_UNUSED(conn);
	ARG_UNUSED(params);

	if (status == BT_HCI_ERR_SUCCESS) {
		LOG_INF("CS capability exchange completed.");
	} else {
		LOG_WRN("CS capability exchange failed. (HCI status 0x%02x)", status);
	}
}

static void config_create_cb(struct bt_conn *conn,
			      uint8_t status,
			      struct bt_conn_le_cs_config *config)
{
	ARG_UNUSED(conn);

	if (status == BT_HCI_ERR_SUCCESS) {
		LOG_INF("CS config creation complete. ID: %d", config->id);
	} else {
		LOG_WRN("CS config creation failed. (HCI status 0x%02x)", status);
	}
}

static void security_enable_cb(struct bt_conn *conn, uint8_t status)
{
	ARG_UNUSED(conn);

	if (status == BT_HCI_ERR_SUCCESS) {
		LOG_INF("CS security enabled.");
	} else {
		LOG_WRN("CS security enable failed. (HCI status 0x%02x)", status);
	}
}

static void procedure_enable_cb(struct bt_conn *conn,
				uint8_t status,
				struct bt_conn_le_cs_procedure_enable_complete *params)
{
	ARG_UNUSED(conn);

	if (status == BT_HCI_ERR_SUCCESS) {
		if (params->state == 1) {
			LOG_INF("CS procedures enabled.");
		} else {
			LOG_INF("CS procedures disabled.");
		}
	} else {
		LOG_WRN("CS procedures enable failed. (HCI status 0x%02x)", status);
	}
}

BT_CONN_CB_DEFINE(conn_cb) = {
	.connected = connected_cb,
	.disconnected = disconnected_cb,
	.le_cs_read_remote_capabilities_complete = remote_capabilities_cb,
	.le_cs_config_complete = config_create_cb,
	.le_cs_security_enable_complete = security_enable_cb,
	.le_cs_procedure_enable_complete = procedure_enable_cb,
};

int main(void)
{
	int err;

	LOG_INF("Starting Channel Sounding Reflector Sample");

	dk_leds_init();
	dk_set_led_on(DK_LED2); // 一开机就点亮 LED1
	dk_set_led_on(DK_LED3);
	dk_set_led_on(DK_LED4);
    // k_sleep(K_FOREVER);     // 挂起
	LOG_INF("Starting Channel Sounding Reflector Sample");
	err = bt_enable(NULL);
	if (err) {
		LOG_ERR("Bluetooth init failed (err %d)", err);
		return 0;
	}

	if (IS_ENABLED(CONFIG_SETTINGS)) {
        settings_load();
		LOG_INF("Settings loaded successfully");
    }

	/* Do NOT clear bonds on boot.
	 *
	 * Android keeps its LTK for this reflector across app restarts. If we wipe
	 * our side of the bond here, the phone reconnects and encrypts with a key we
	 * no longer have, the controller answers "PIN or Key Missing" (HCI 0x06) and
	 * Android drops the link (logcat: encryption_change:key_missing). CS security
	 * needs an encrypted link, so ranging never starts. android_ranging.conf
	 * enables CONFIG_BT_BONDABLE/CONFIG_BT_SETTINGS precisely so the bond
	 * survives; settings_load() above restores it from NVS.
	 */

	// 2. 检查是否真的加载到了 ID
	bt_addr_le_t addrs[1];
	size_t count = 1;
	bt_id_get(addrs, &count);

	if (count == 0) {
		// 如果没有 ID，则手动创建一个，这会消除 "No ID address" 警告
		LOG_INF("No ID found, creating a new permanent ID...");
		err = bt_id_create(NULL, NULL);
		if (err < 0) {
			LOG_ERR("Failed to create ID (err %d)", err);
		}
		
		// 3. 强制保存到 Flash
		if (IS_ENABLED(CONFIG_SETTINGS)) {
			settings_save();
		}
	}

	LOG_INF("Settings loaded successfully. Identity ready.");

	k_sleep(K_MSEC(500));
	err = bt_le_adv_start(BT_LE_ADV_CONN_FAST_2, ad, ARRAY_SIZE(ad), NULL, 0);
	if (err) {
		LOG_ERR("Advertising failed to start (err %d)", err);
		return 0;
	}

	while (true) {
		k_sem_take(&sem_connected, K_FOREVER);

		const struct bt_le_cs_set_default_settings_param default_settings = {
			.enable_initiator_role = false,
			.enable_reflector_role = true,
			.cs_sync_antenna_selection = BT_LE_CS_ANTENNA_SELECTION_OPT_REPETITIVE,
			.max_tx_power = BT_HCI_OP_LE_CS_MAX_MAX_TX_POWER,
		};

		err = bt_le_cs_set_default_settings(connection, &default_settings);
		if (err) {
			LOG_ERR("Failed to configure default CS settings (err %d)", err);
		}
	}

	return 0;
}
```
